## main/Kconfig.projbuild
```kconfig
menu "WiFi and Pi-Hole credentials"
config WIFI_SSID
    string "WiFi SSID"
    default "myssid"
    help
    SSID (network name).

config WIFI_PASSWORD
    string "WiFi Password"
    default "mypassword"
    help
    WiFi password (WPA or WPA2).

config PI_HOLE_TOKEN
    string "API token from pi.hole"
    default "1234"
    help
    Token revealed at http://pi.hole/admin/settings.php?tab=api

endmenu
```
